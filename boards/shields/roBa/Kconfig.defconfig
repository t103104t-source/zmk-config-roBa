## boards/shields/roBa/Kconfig.defconfig
```kconfig
# 右側をビルドしたときの既定値。
if SHIELD_ROBA_R

# ファームウェア名。Bluetooth 接続時などに roBa_R と表示する。
config ZMK_KEYBOARD_NAME
    default "roBa_R"

# 左右分離キーボードとして動作させる。
config ZMK_SPLIT
    default y

# 右側を親機（Bluetooth 接続を管理する側）にする。
config ZMK_SPLIT_ROLE_CENTRAL
    default y

endif

# 左側をビルドしたときの既定値。
if SHIELD_ROBA_L

# ファームウェア名。Bluetooth 接続時などに roBa_L と表示する。
config ZMK_KEYBOARD_NAME
    default "roBa_L"

# 左右分離キーボードとして動作させる。
config ZMK_SPLIT
    default y

endif
```

## boards/shields/roBa/Kconfig.shield
```kconfig
# 右側シールドを選択したときに有効にする設定。
config SHIELD_ROBA_R
    def_bool $(shields_list_contains,roBa_R)

# 左側シールドを選択したときに有効にする設定。
config SHIELD_ROBA_L
    def_bool $(shields_list_contains,roBa_L)
```
