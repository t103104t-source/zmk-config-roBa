// 左側シールド用の共通デバイスツリー設定を読み込む。
#include "roBa.dtsi"

// 左側で使う列ピンを指定する。
&kscan0 {
        // 左手側の 6 列を XIAO の各 GPIO に接続する。
        col-gpios
            = <&xiao_d 10 GPIO_ACTIVE_HIGH>
            , <&xiao_d 9 GPIO_ACTIVE_HIGH> 
            , <&xiao_d 8 GPIO_ACTIVE_HIGH> 
            , <&xiao_d 7 GPIO_ACTIVE_HIGH> 
            , <&gpio0 10 GPIO_ACTIVE_HIGH>
            , <&gpio0 9 GPIO_ACTIVE_HIGH>
            ;
};

// 左側のロータリーエンコーダーを有効にする。
&left_encoder {
    status = "okay";
};

// 分離通信では使わない UART を無効にする。
&xiao_serial { status = "disabled"; };
